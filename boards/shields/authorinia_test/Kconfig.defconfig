## boards/shields/authorinia_test/Kconfig.defconfig
```kconfig
if SHIELD_AUTHORINIA_TEST_LEFT

config ZMK_KEYBOARD_NAME
    default "authorinia_test"

endif

if SHIELD_AUTHORINIA_TEST_LEFT || SHIELD_AUTHORINIA_TEST_RIGHT

config ZMK_SPLIT
    default y

endif
```

## boards/shields/authorinia_test/Kconfig.shield
```kconfig
config SHIELD_AUTHORINIA_TEST_LEFT
    def_bool $(shields_list_contains,authorinia_test_left)
config SHIELD_AUTHORINIA_TEST_RIGHT
    def_bool $(shields_list_contains,authorinia_test_right)
```
